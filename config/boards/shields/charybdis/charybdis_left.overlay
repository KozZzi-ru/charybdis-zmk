/*
 * Copyright (c) 2020 ZMK Contributors
 *
 * SPDX-License-Identifier: MIT
 */

#include "charybdis.dtsi"

#include <input/processors.dtsi>
#include <dt-bindings/zmk/input_transform.h>

&kscan0 {
    col-gpios = <&pro_micro 19 (GPIO_ACTIVE_HIGH | GPIO_PULL_DOWN)>
                , <&pro_micro 20 (GPIO_ACTIVE_HIGH | GPIO_PULL_DOWN)>
                , <&pro_micro 10 (GPIO_ACTIVE_HIGH | GPIO_PULL_DOWN)>
                , <&pro_micro 16 (GPIO_ACTIVE_HIGH | GPIO_PULL_DOWN)>
                , <&pro_micro 15 (GPIO_ACTIVE_HIGH | GPIO_PULL_DOWN)>
                , <&pro_micro 8  (GPIO_ACTIVE_HIGH | GPIO_PULL_DOWN)>;
};

&pmw_listener {
    status = "okay";

    // Глобальная инверсия X/Y — курсор всегда движется как нужно
    input-processors = <
        &zip_xy_transform (INPUT_TRANSFORM_X_INVERT | INPUT_TRANSFORM_Y_INVERT)
        &zip_temp_layer 3 1000
    >;

    // Scroll: горизонтальная ось без инверсии; вертикальная прокрутка инвертирована (движение шара вниз — страница вниз)
    scroller {
        layers = <3>;
        input-processors = <
            &zip_xy_transform (INPUT_TRANSFORM_X_INVERT) // только X, чтобы Y не инвертировался
            &zip_xy_scaler 1 10                         // скорость чуть выше
            &zip_scroll_scaler 3 2                      // плавность +100%
            &zip_xy_to_scroll_mapper
        >;
    };

    // Sniper режим — как обычный курсор, только чувствительней
    snipe {
        layers = <4>;
        input-processors = <
            &zip_xy_transform (INPUT_TRANSFORM_X_INVERT | INPUT_TRANSFORM_Y_INVERT)
            &zip_xy_scaler 1 1   // ускорение
        >;
    };
};
